#define DEFAULT 0
#define QWERT   1
#define NUM     2
#define SYM     3


    behaviors {
      cmqus: comma_question {
        compatible = "zmk,behavior-mod-morph";
        label = "COMMA_QUESTION";
        #binding-cells = <0>;
        bindings = <&kp COMMA>, <&kp QUESTION>;
        mods = <(MOD_LSFT|MOD_RSFT)>;
      };

      dtsmi: dot_semi {
        compatible = "zmk,behavior-mod-morph";
        label = "DOT_SEMI";
        #binding-cells = <0>;
        bindings = <&kp DOT>, <&kp SEMI>;
        mods = <(MOD_LSFT|MOD_RSFT)>;
        masked_mods = <(MOD_LSFT|MOD_RSFT)>; // don't send shift
      };
    };
